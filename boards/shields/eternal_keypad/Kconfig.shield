## boards/shields/eternal_keypad/Kconfig.shield
```kconfig
# No whitespace after the comma or in the keyboard name!
config SHIELD_ETERNAL_KEYPAD_DONGLE
    def_bool $(shields_list_contains,eternal_keypad_dongle)
```
